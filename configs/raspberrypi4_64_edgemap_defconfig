## configs/raspberrypi4_64_edgemap_defconfig
```kconfig
BR2_aarch64=y
BR2_cortex_a72=y
BR2_ARM_FPU_VFPV4=y
BR2_PACKAGE_HOST_LINUX_HEADERS_CUSTOM_5_15=y
BR2_TOOLCHAIN_BUILDROOT_CXX=y
BR2_INIT_SYSTEMD=y
BR2_TARGET_GENERIC_ROOT_PASSWD="root"
BR2_SYSTEM_DHCP="eth0"
BR2_SYSTEM_DEFAULT_PATH="/bin:/sbin:/usr/bin:/usr/sbin"
BR2_ROOTFS_OVERLAY="${BR2_EXTERNAL}/board/raspberrypi4/fs"
BR2_ROOTFS_POST_BUILD_SCRIPT="board/raspberrypi4-64/post-build.sh"
BR2_ROOTFS_POST_IMAGE_SCRIPT="board/raspberrypi4-64/post-image.sh"
BR2_LINUX_KERNEL=y
BR2_LINUX_KERNEL_CUSTOM_TARBALL=y
BR2_LINUX_KERNEL_CUSTOM_TARBALL_LOCATION="$(call github,raspberrypi,linux,3e2b55bf16ebcdc0cc4585e57463d32635161611)/linux-3e2b55bf16ebcdc0cc4585e57463d32635161611.tar.gz"
BR2_LINUX_KERNEL_USE_CUSTOM_CONFIG=y
BR2_LINUX_KERNEL_CUSTOM_CONFIG_FILE="${BR2_EXTERNAL}/profiles/kernel/rpi4-64-kernel-macsec.config"
BR2_LINUX_KERNEL_DTS_SUPPORT=y
BR2_LINUX_KERNEL_INTREE_DTS_NAME="broadcom/bcm2711-rpi-4-b"
BR2_LINUX_KERNEL_NEEDS_HOST_OPENSSL=y
BR2_PACKAGE_MOTION=y
BR2_PACKAGE_LINUX_FIRMWARE=y
BR2_PACKAGE_LINUX_FIRMWARE_ATHEROS_6002=y
BR2_PACKAGE_LINUX_FIRMWARE_ATHEROS_6003=y
BR2_PACKAGE_LINUX_FIRMWARE_ATHEROS_6004=y
BR2_PACKAGE_LINUX_FIRMWARE_ATHEROS_7010=y
BR2_PACKAGE_LINUX_FIRMWARE_ATHEROS_9170=y
BR2_PACKAGE_LINUX_FIRMWARE_ATHEROS_9271=y
BR2_PACKAGE_LINUX_FIRMWARE_ATHEROS_10K_QCA9377=y
BR2_PACKAGE_LINUX_FIRMWARE_ATHEROS_10K_QCA998X=y
BR2_PACKAGE_LINUX_FIRMWARE_RALINK_RT61=y
BR2_PACKAGE_LINUX_FIRMWARE_RALINK_RT73=y
BR2_PACKAGE_LINUX_FIRMWARE_RALINK_RT2XX=y
BR2_PACKAGE_LINUX_FIRMWARE_RTL_81XX=y
BR2_PACKAGE_LINUX_FIRMWARE_RTL_87XX=y
BR2_PACKAGE_LINUX_FIRMWARE_RTL_88XX=y
BR2_PACKAGE_RPI_FIRMWARE=y
BR2_PACKAGE_RPI_FIRMWARE_VARIANT_PI4=y
BR2_PACKAGE_RPI_FIRMWARE_CONFIG_FILE="board/raspberrypi4-64/config_4_64bit.txt"
BR2_PACKAGE_PHP=y
BR2_PACKAGE_PHP_SAPI_APACHE=y
BR2_PACKAGE_PHP_SAPI_CGI=y
BR2_PACKAGE_PHP_EXT_SQLITE=y
BR2_PACKAGE_PHP_EXT_PDO=y
BR2_PACKAGE_PHP_EXT_PDO_SQLITE=y
BR2_PACKAGE_PHP_EXT_XML=y
BR2_PACKAGE_PYTHON3_PY_PYC=y
BR2_PACKAGE_PYTHON_PIP=y
BR2_PACKAGE_LIBOPENSSL_BIN=y
BR2_PACKAGE_SQLITE_ENABLE_JSON1=y
BR2_PACKAGE_BATMAN_ADV=y
BR2_PACKAGE_APACHE=y
BR2_PACKAGE_BATCTL=y
BR2_PACKAGE_ETHTOOL=y
BR2_PACKAGE_GLORYTUN=y
BR2_PACKAGE_IODINE=y
BR2_PACKAGE_IPERF3=y
BR2_PACKAGE_IPROUTE2=y
BR2_PACKAGE_IW=y
BR2_PACKAGE_IWD=y
BR2_PACKAGE_JANUS_GATEWAY=y
BR2_PACKAGE_JANUS_GATEWAY_DEMOS=y
BR2_PACKAGE_JANUS_GATEWAY_AUDIO_BRIDGE=y
BR2_PACKAGE_JANUS_GATEWAY_ECHO_TEST=y
BR2_PACKAGE_JANUS_GATEWAY_RECORDPLAY=y
BR2_PACKAGE_JANUS_GATEWAY_SIP_GATEWAY=y
BR2_PACKAGE_JANUS_GATEWAY_STREAMING=y
BR2_PACKAGE_JANUS_GATEWAY_TEXT_ROOM=y
BR2_PACKAGE_JANUS_GATEWAY_VIDEO_CALL=y
BR2_PACKAGE_JANUS_GATEWAY_VIDEO_ROOM=y
BR2_PACKAGE_JANUS_GATEWAY_REST=y
BR2_PACKAGE_JANUS_GATEWAY_WEBSOCKETS=y
BR2_PACKAGE_NETCAT=y
BR2_PACKAGE_NFTABLES=y
BR2_PACKAGE_OPENSSH=y
BR2_PACKAGE_RSYNC=y
BR2_PACKAGE_SMCROUTE=y
BR2_PACKAGE_TCPDUMP=y
BR2_PACKAGE_TRACEROUTE=y
BR2_PACKAGE_WIREGUARD_TOOLS=y
BR2_PACKAGE_HTOP=y
BR2_PACKAGE_NANO=y
BR2_TARGET_ROOTFS_EXT2=y
BR2_TARGET_ROOTFS_EXT2_4=y
BR2_TARGET_ROOTFS_EXT2_SIZE="600M"
# BR2_TARGET_ROOTFS_TAR is not set
BR2_PACKAGE_HOST_DOSFSTOOLS=y
BR2_PACKAGE_HOST_GENIMAGE=y
BR2_PACKAGE_HOST_MTOOLS=y
BR2_PACKAGE_NKMACSEC=y
BR2_PACKAGE_PYTHON_DATEUTILS=y
BR2_PACKAGE_PYTHON_TAKY=y
BR2_PACKAGE_GWSOCKET=y
BR2_PACKAGE_HIGHRATE=y
BR2_PACKAGE_CURLCOT=y
BR2_PACKAGE_COTSIM=y
BR2_PACKAGE_TACMSGROUTER=y
BR2_PACKAGE_AUDIORECEIVER=y
BR2_PACKAGE_AUDIOSTREAMER=y
```
